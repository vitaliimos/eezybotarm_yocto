## meta-eezybot-distro/conf/layer.conf
```bitbake
BBPATH .= ":${LAYERDIR}"

BBFILES += "${LAYERDIR}/recipes-*/*/*.bb ${LAYERDIR}/recipes-*/*/*.bbappend"

BBFILE_COLLECTIONS += "eezybot-distro"
BBFILE_PATTERN_eezybot-distro = "^${LAYERDIR}/"
BBFILE_PRIORITY_eezybot-distro = "15"

LAYERVERSION_eezybot-distro = "1"
LAYERSERIES_COMPAT_eezybot-distro = "wrynose"
LAYERDEPENDS_eezybot-distro = "core openembedded-layer meta-python networking-layer tegra ros2-layer ros2-jazzy-layer eezybot"
```

## meta-eezybot/conf/layer.conf
```bitbake
BBPATH .= ":${LAYERDIR}"

BBFILES += "${LAYERDIR}/recipes-*/*/*.bb ${LAYERDIR}/recipes-*/*/*.bbappend"

BBFILE_COLLECTIONS += "eezybot"
BBFILE_PATTERN_eezybot = "^${LAYERDIR}/"
BBFILE_PRIORITY_eezybot = "10"

LAYERVERSION_eezybot = "1"
LAYERSERIES_COMPAT_eezybot = "wrynose"
LAYERDEPENDS_eezybot = "core openembedded-layer ros2-jazzy-layer"
```

## meta-ros-tegra-fixes/conf/layer.conf
```bitbake
BBPATH .= ":${LAYERDIR}"

BBFILES += "${LAYERDIR}/recipes-*/*/*.bb ${LAYERDIR}/recipes-*/*/*.bbappend"

BBFILE_COLLECTIONS += "ros-tegra-fixes"
BBFILE_PATTERN_ros-tegra-fixes = "^${LAYERDIR}/"
BBFILE_PRIORITY_ros-tegra-fixes = "15"

LAYERVERSION_ros-tegra-fixes = "1"
LAYERSERIES_COMPAT_ros-tegra-fixes = "wrynose"
LAYERDEPENDS_ros-tegra-fixes = "core tegra ros2-jazzy-layer"
```
